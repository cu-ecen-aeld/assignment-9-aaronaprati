## base_external/package/ldd/Config.in
```kconfig
config BR2_PACKAGE_LDD
    bool "ldd"
    depends on BR2_LINUX_KERNEL
    help
        Description of the ldd package. Installs the Linux Device drivers example 
```
